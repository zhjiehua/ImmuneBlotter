///*
//*********************************************************************************************************
//*	                                  
//*	模块名称 : GUI界面任务
//*	文件名称 : MainTask.c
//*	版    本 : V1.0
//*	说    明 : GUI界面主函数，注意以下事项：
//*              1. 所有使用emWin的工程都可以用此程序做四点触摸校准，校准后参数将保存到EEPROM里面
//*                 其它工程使用的时候可以自动加载。
//*              2. 电阻屏需要校准，电容屏无需校准。
//*              3. 四点触摸校准后实现了一个简单的画板功能，用户可以检测校准是否准确。
//*
//*	修改记录 :
//*		版本号    日期         作者            说明
//*       V1.0    2015-09-28   Eric2013    1. ST固件库到V3.6.1版本
//*                                        2. BSP驱动包V1.2
//*                                        3. STemWin版本V5.28   
//*
//*      Copyright (C), 2015-2020, 安富莱电子 www.armfly.com
//*
//*********************************************************************************************************
//*/
//#include "MainTask.h"


///* 调用bsp_touch.c文件中的触摸校准函数 */
//extern void TOUCH_Calibration(void);

///*
//*********************************************************************************************************
//*	函 数 名: MainTask
//*	功能说明: GUI主函数
//*	形    参: 无   	
//*	返 回 值: 无
//*********************************************************************************************************
//*/
//		
//void MainTask(void) 
//{ 
//	GUI_PID_STATE PIDState;
//	
//    GUI_Init();                /* 初始化 */
//	TOUCH_Calibration();       /* 四点触摸校准 */
//	GUI_CURSOR_Show();         /* 显示鼠标 */
//	GUI_SetBkColor(GUI_WHITE); /* 设置背景色 */
//	GUI_SetColor(GUI_BLACK);   /* 设置前景色 */
//	GUI_Clear();
//	GUI_SetFont(&GUI_Font24B_1);
//	GUI_DispStringAt("Draw Panel", 0, 0);
//	
//	/* 
//		连续读取5次，因为emWin的PID输入管理器含有一个FIFO缓冲器，
//	默认情况下最多可以保存5个PID事件，下面连续读取5次相当于清空FIFO.
//	防止触摸校准的时点击的点显示到画板上面。
//	*/
//	GUI_PID_GetState(&PIDState);
//	GUI_PID_GetState(&PIDState);
//	GUI_PID_GetState(&PIDState);
//	GUI_PID_GetState(&PIDState);
//	GUI_PID_GetState(&PIDState);
//	
//	while(1) 
//	{
//		GUI_PID_GetState(&PIDState);
//		if (PIDState.Pressed == 1) 
//		{
//			GUI_SetPenSize(5);
//			/* 为了防止游标不显示或者不跟着移动，这里添加如下函数 */
//			GUI_CURSOR_SetPosition(PIDState.x, PIDState.y);
//			GUI_DrawPoint(PIDState.x, PIDState.y);
//		}
//		GUI_Delay(1);
//	}
//}

///***************************** 安富莱电子 www.armfly.com (END OF FILE) *********************************/
















/*
*********************************************************************************************************
*	                                  
*	模块名称 : GUI界面任务
*	文件名称 : MainTask.c
*	版    本 : V1.0
*	说    明 : 开机后会自动加载存储在EEPROM里面的触摸参数
*
*	修改记录 :
*		版本号    日期         作者            说明
*       V1.0    2015-09-28   Eric2013    1. ST固件库到V3.6.1版本
*                                        2. BSP驱动包V1.2
*                                        3. STemWin版本V5.28   
*
*      Copyright (C), 2015-2020, 安富莱电子 www.armfly.com
*
*********************************************************************************************************
*/
#include "MainTask.h"
#include "WFGUI_DeskTop.h"

/* 调用bsp_touch.c文件中的触摸校准函数 */
extern void TOUCH_Calibration(void);

/*
*********************************************************************************************************
*                                         segger的logo
*********************************************************************************************************
*/  
static const GUI_COLOR ColorsSeggerLogoBlue16[] = {
     0x0000FF,0x000000,0x888888,0xFFFFFF
    ,0xFF0000,0xBBBBBB
};

static const GUI_LOGPALETTE PalSeggerLogoBlue16 = {
  6,	/* 调色板支持颜色数 */
  1, 	/* 透明 */
  &ColorsSeggerLogoBlue16[0]
};

static const unsigned char acSeggerLogoBlue16[] = {
  0x00, 0x00, 0x00, 0x00, 0x00, 0x00, 0x00, 0x00, 0x00, 0x00, 0x00, 0x00,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 0x00,
  0x00, 0x01, 0x11, 0x11, 0x11, 0x11, 0x11, 0x11, 0x11, 0x11, 0x11, 0x11,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 0x00,
  0x00, 0x11, 0x11, 0x11, 0x11, 0x11, 0x11, 0x11, 0x11, 0x11, 0x11, 0x11,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 0x00,
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  0x00, 0x00, 0x01, 0x11, 0x11, 0x11, 0x11, 0x11, 0x11, 0x11, 0x11, 0x11,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 0x00
};

static const GUI_BITMAP bmSeggerLogoBlue = 
{
	138, 	/* X大小 */
	65, 	/* Y大小 */
	69, 	/* 每行字节数 */
	4, 		/* 每个像素需要位数 */
	acSeggerLogoBlue16,   /* 图片数据 */
	&PalSeggerLogoBlue16  /* 调试板 */
};

/*
*********************************************************************************************************
*                                     GUI_WIDGET_CREATE_INFO类型数组    
*********************************************************************************************************
*/  
static const GUI_WIDGET_CREATE_INFO _aDialogCreate[] = {
  { FRAMEWIN_CreateIndirect, "Adjust color", 0,         10,  40, 300, 160, FRAMEWIN_CF_MOVEABLE},
  { TEXT_CreateIndirect,     "Red:" ,  0,                5,  20,  35,  20, TEXT_CF_LEFT },
  { TEXT_CreateIndirect,     "Green:", 0,                5,  50,  35,  20, TEXT_CF_LEFT },
  { TEXT_CreateIndirect,     "Blue:",  0,                5,  80,  35,  20, TEXT_CF_LEFT },
  { TEXT_CreateIndirect,     "Preview",0,              205,   4,  81,  15, TEXT_CF_HCENTER },
  { SLIDER_CreateIndirect,   NULL,     GUI_ID_SLIDER0,  40,  20, 100,  20 },
  { SLIDER_CreateIndirect,   NULL,     GUI_ID_SLIDER1,  40,  50, 100,  20 },
  { SLIDER_CreateIndirect,   NULL,     GUI_ID_SLIDER2,  40,  80, 100,  20 },
  { EDIT_CreateIndirect,     NULL,     GUI_ID_EDIT0,   145,  20,  30,  20, 0, 3 },
  { EDIT_CreateIndirect,     NULL,     GUI_ID_EDIT1,   145,  50,  30,  20, 0, 3 },
  { EDIT_CreateIndirect,     NULL,     GUI_ID_EDIT2,   145,  80,  30,  20, 0, 3 },
  { BUTTON_CreateIndirect,   "OK",     GUI_ID_OK,       10, 110,  60,  20 },
  { BUTTON_CreateIndirect,   "Cancel", GUI_ID_CANCEL,  230, 110,  60,  20 },
};

static U8 _aColorSep[3] = {0, 127, 255};  /* 颜色值 */

/*
*********************************************************************************************************
*	函 数 名: _OnPaint
*	功能说明: 对话框回调函数中重绘消息的执行函数
*	形    参: 无
*	返 回 值: 无
*********************************************************************************************************
*/
static void _OnPaint(void) 
{
	GUI_SetColor(_aColorSep[0]);
	GUI_FillRect(180, 20, 199, 39);
	GUI_SetColor(_aColorSep[1] << 8);
	GUI_FillRect(180, 50, 199, 69);
	GUI_SetColor(((U32)_aColorSep[2]) << 16);
	GUI_FillRect(180, 80, 199, 99);
	GUI_SetColor(_aColorSep[0] | (((U32)_aColorSep[1]) << 8) | (((U32)_aColorSep[2]) << 16));
	GUI_FillRect(205, 20, 285, 99);
}

/*
*********************************************************************************************************
*	函 数 名: _OnValueChanged
*	功能说明: 对话框回调函数中WM_NOTIFY_PARENT消息的执行函数
*	形    参: hDlg  句柄
*              Id   控件ID
*	返 回 值: 无
*********************************************************************************************************
*/
static void _OnValueChanged(WM_HWIN hDlg, int Id) 
{
	unsigned Index, v;
	WM_HWIN hSlider, hEdit;
	
	/* SLIDER的数值改变更新EDIT */
	if ((Id >= GUI_ID_SLIDER0) && (Id <= GUI_ID_SLIDER2)) 
	{
		Index = Id - GUI_ID_SLIDER0;
		hSlider = WM_GetDialogItem(hDlg, GUI_ID_SLIDER0 + Index);
		hEdit   = WM_GetDialogItem(hDlg, GUI_ID_EDIT0 + Index);
		v = SLIDER_GetValue(hSlider);
		EDIT_SetValue(hEdit, v);
	}
	/* EDIT的数值改变，更新SLIDER */ 
	else if ((Id >= GUI_ID_EDIT0) && (Id <= GUI_ID_EDIT2)) 
	{
		Index = Id - GUI_ID_EDIT0;
		hSlider = WM_GetDialogItem(hDlg, GUI_ID_SLIDER0 + Index);
		hEdit   = WM_GetDialogItem(hDlg, GUI_ID_EDIT0 + Index);
		v = EDIT_GetValue(hEdit);
		SLIDER_SetValue(hSlider, v);
	}
	
	_aColorSep[Index] = v;
	/* 使窗口无效，从而使得窗口执行重绘 */
	WM_InvalidateWindow(WM_GetClientWindow(hDlg));
}

/*
*********************************************************************************************************
*	函 数 名: _cbBkWindow
*	功能说明: 桌面窗口回调函数
*	形    参: pMsg  GUI消息
*	返 回 值: 无
*********************************************************************************************************
*/
static void _cbBkWindow(WM_MESSAGE * pMsg) 
{
	int xPos, yPos;
	xPos = LCD_GetXSize() / 2 - bmSeggerLogoBlue.XSize/2;
	yPos = LCD_GetYSize() / 2 - bmSeggerLogoBlue.YSize/2 ;
	
	switch (pMsg->MsgId) 
	{
		case WM_PAINT:
		//重绘，显示实验的title和一个图标
		GUI_SetBkColor(GUI_BLUE);
		GUI_Clear();
		GUI_SetColor(GUI_WHITE);
		GUI_SetFont(&GUI_Font24_ASCII);
		GUI_DispStringHCenterAt("DIALOG_SliderColor - Sample", 160, 5);
		GUI_DrawBitmap(&bmSeggerLogoBlue, xPos, yPos );
		
		default:
			WM_DefaultProc(pMsg);
	}
}

/*
*********************************************************************************************************
*	函 数 名: _cbCallback
*	功能说明: 对话框回调函数
*	形    参: pMsg  GUI消息
*	返 回 值: 无
*********************************************************************************************************
*/
static void _cbCallback(WM_MESSAGE * pMsg) 
{
	int i;
	int NCode, Id;
	WM_HWIN hDlg, hItem;
	hDlg = pMsg->hWin;
	switch (pMsg->MsgId) 
	{
		/* 重绘消息 */
		case WM_PAINT:
			_OnPaint();
			return;
		
		/* 初始化消息 */
		case WM_INIT_DIALOG:
			for (i = 0; i < 3; i++) 
			{
				hItem = WM_GetDialogItem(hDlg, GUI_ID_SLIDER0 + i);
				SLIDER_SetRange(hItem, 0, 255);
				SLIDER_SetValue(hItem, _aColorSep[i]);
				hItem = WM_GetDialogItem(hDlg, GUI_ID_EDIT0 + i);
				EDIT_SetDecMode(hItem, _aColorSep[i],   0, 255, 0, 0);
			}
			break;
			
		case WM_KEY:
			switch (((WM_KEY_INFO*)(pMsg->Data.p))->Key) 
			{
				case GUI_KEY_ESCAPE:
					;
					break;
				
				case GUI_KEY_ENTER:
					GUI_EndDialog(hDlg, 0);
					break;
			}
			break;
		
		case WM_NOTIFY_PARENT:
			Id    = WM_GetId(pMsg->hWinSrc);     
			NCode = pMsg->Data.v;               
			switch (NCode) 
			{
				case WM_NOTIFICATION_RELEASED:     
					if (Id == GUI_ID_OK) 
					{            
						GUI_EndDialog(hDlg, 0);
					}
					if (Id == GUI_ID_CANCEL) 
					{       
						GUI_EndDialog(hDlg, 1);
					}
					break;
				
				case WM_NOTIFICATION_VALUE_CHANGED: 
					_OnValueChanged(hDlg, Id);
					break;
			}
			break;
		
		default:
			WM_DefaultProc(pMsg);
	}
}

/*
*********************************************************************************************************
*	函 数 名: MainTask
*	功能说明: GUI主函数
*	形    参: 无
*	返 回 值: 无
*********************************************************************************************************
*/
void MainTask(void) 
{
	GUI_PID_STATE PIDState;
	
	/* 初始化 */ 
	GUI_Init();
	
	/* 
		连续读取5次，因为emWin的PID输入管理器含有一个FIFO缓冲器，
	默认情况下最多可以保存5个PID事件，下面连续读取5次相当于清空FIFO.
	防止触摸校准的时点击的点显示到画板上面。
	*/
#if 1
	GUI_PID_GetState(&PIDState);
	GUI_PID_GetState(&PIDState);
	GUI_PID_GetState(&PIDState);
	GUI_PID_GetState(&PIDState);
	GUI_PID_GetState(&PIDState);
	
	GUI_PID_GetState(&PIDState);
	if(PIDState.Pressed == 1)
		TOUCH_Calibration();       /* 四点触摸校准 */
#endif

	GUI_CURSOR_Show();

#if 1	
	WFGUI_MainTask();
#else	
	/* 设置桌面窗口的回调函数 */
	WM_SetCallback(WM_HBKWIN, _cbBkWindow);  
	WM_SetCreateFlags(WM_CF_MEMDEV);  /* 使能窗口使用内存设备，防止闪烁 */
	
	while(1)
	{
		GUI_ExecDialogBox(_aDialogCreate, GUI_COUNTOF(_aDialogCreate), &_cbCallback, 0, 0, 0);
		
//		GUI_PID_GetState(&PIDState);
//		if (PIDState.Pressed == 1) 
//		{
//			GUI_SetPenSize(5);
//			/* 为了防止游标不显示或者不跟着移动，这里添加如下函数 */
//			GUI_CURSOR_SetPosition(PIDState.x, PIDState.y);
//			GUI_DrawPoint(PIDState.x, PIDState.y);
//		}
		
		GUI_Delay(1000);
	}
#endif
}

/***************************** 安富莱电子 www.armfly.com (END OF FILE) *********************************/

